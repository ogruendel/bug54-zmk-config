## boards/shields/bug54/Kconfig.shield
```kconfig
config SHIELD_BUG54_LEFT
    def_bool $(shields_list_contains,bug54_left)

config SHIELD_BUG54_RIGHT
    def_bool $(shields_list_contains,bug54_right)
```

## boards/shields/splitkb/Kconfig.defconfig
```kconfig
if SHIELD_SPLITKB_LEFT

config ZMK_KEYBOARD_NAME
    default "SplitKB"

config ZMK_SPLIT_ROLE_CENTRAL
    default y

endif

if SHIELD_SPLITKB_LEFT || SHIELD_SPLITKB_RIGHT

config ZMK_SPLIT
    default y

endif
```

## boards/shields/splitkb/Kconfig.shield
```kconfig
config SHIELD_SPLITKB_LEFT
    def_bool $(shields_list_contains, splitkb_left)

config SHIELD_SPLITKB_RIGHT
    def_bool $(shields_list_contains, splitkb_right)
```

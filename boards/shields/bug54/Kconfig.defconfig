## boards/shields/bug54/Kconfig.defconfig
```kconfig
if SHIELD_BUG54_DONGLE

config ZMK_KEYBOARD_NAME
    default "Bug54"

config ZMK_SPLIT_ROLE_CENTRAL
    default y

config ZMK_SPLIT
    default y

config ZMK_SPLIT_BLE_CENTRAL_PERIPHERALS
    default 2

config BT_MAX_CONN
    default 5

config BT_MAX_PAIRED
    default 5

endif

if SHIELD_BUG54_LEFT || SHIELD_BUG54_RIGHT
    
config ZMK_SPLIT
    default y

config ZMK_SPLIT_ROLE_CENTRAL
    default n

endif
```
